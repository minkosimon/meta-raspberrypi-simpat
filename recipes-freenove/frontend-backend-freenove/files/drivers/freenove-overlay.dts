/dts-v1/;
/plugin/;

/{
    compatible = "brcm,bcm2712";

    /* Fragment 0: Freenove GPIO LED driver */
    fragment@0 {
        target-path = "/";
        __overlay__ {
            freenove_board: freenove_board {
                compatible = "simpat,freenove-driver";
                freenove,i2c-bus = <1>;
                freenove,adc-address = <0x4b>;
                freenove,thermistor-channel = <0>;
                leds-gpios = <&gpio 4 0>, <&gpio 5 0>,
                        <&gpio 6 0>, <&gpio 12 0>,
                        <&gpio 13 0>, <&gpio 17 0>,
                        <&gpio 18 0>, <&gpio 22 0>,
                        <&gpio 23 0>, <&gpio 24 0>,
                        <&gpio 25 0>, <&gpio 26 0>,
                        <&gpio 27 0>;
                delay-on = <500>;
                delay-off = <250>;
                status = "okay";
            };
        };
    };

    /* Fragment 1: Enable RP1 I2C1 (GPIO2=SDA, GPIO3=SCL) for user I2C bus. */
    fragment@1 {
        target = <&i2c_arm>;
        __overlay__ {
            status = "okay";
        };
    };
};
