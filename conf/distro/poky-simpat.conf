## conf/distro/poky-simpat.conf
```bitbake
# this distribution configuration file is used 
# to build a custom image with Python support for the Simpat project.
require conf/distro/poky.conf

DISTRO = "poky-simpat"
DISTRO_NAME = "Poky Simpat Distribution"

# Ajout des packages Python dans l'image par défaut
DISTRO_FEATURES:append = " python3 systemd"

#remove
DISTRO_FEATURES:remove = " sysvinit"

# Ajout des packages dans toutes les images
IMAGE_INSTALL:append = " python3 python3-pip python3-modules "

VIRTUAL-RUNTIME_init_manager = "systemd"
VIRTUAL-RUNTIME_initscripts = ""
```

## conf/layer.conf
```bitbake
# We have a conf and classes directory, add to BBPATH
BBPATH .= ":${LAYERDIR}"

# We have recipes-* directories, add to BBFILES
BBFILES += "${LAYERDIR}/recipes-*/*/*.bb \
            ${LAYERDIR}/recipes-*/*/*.bbappend"

BBFILE_COLLECTIONS += "meta-raspberrypi-simpat"
BBFILE_PATTERN_meta-raspberrypi-simpat = "^${LAYERDIR}/"
BBFILE_PRIORITY_meta-raspberrypi-simpat = "6"

LAYERDEPENDS_meta-raspberrypi-simpat = "core raspberrypi"
LAYERSERIES_COMPAT_meta-raspberrypi-simpat = "kirkstone"
```
